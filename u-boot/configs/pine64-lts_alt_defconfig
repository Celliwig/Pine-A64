## u-boot/configs/pine64-lts_alt_defconfig
```kconfig
CONFIG_ARM=y
CONFIG_ARCH_SUNXI=y
CONFIG_SPL=y
CONFIG_MACH_SUN50I=y
CONFIG_SUNXI_DRAM_LPDDR3_STOCK=y
CONFIG_DRAM_CLK=552
CONFIG_DRAM_ZQ=3881949
CONFIG_MMC0_CD_PIN=""
CONFIG_MMC_SUNXI_SLOT_EXTRA=2
CONFIG_SPL_SPI_SUNXI=y
CONFIG_DEFAULT_DEVICE_TREE="sun50i-a64-pine64-lts"
# CONFIG_SYS_MALLOC_CLEAR_ON_INIT is not set
CONFIG_SUN8I_EMAC=y
CONFIG_USB_EHCI_HCD=y
CONFIG_USB_OHCI_HCD=y

# Extras
############################
# MTD
CONFIG_MTD_PARTITIONS=y
CONFIG_MTD=y
CONFIG_DM_MTD=y
#CONFIG_SYS_MTDPARTS_RUNTIME=y
CONFIG_SYS_FLASH_USE_BUFFER_WRITE=y
CONFIG_FLASH_CFI_DRIVER=y
CONFIG_CFI_FLASH=y
CONFIG_FLASH_CFI_MTD=y
CONFIG_SYS_FLASH_PROTECTION=y
CONFIG_SYS_FLASH_CFI=y

# SPI Flash
CONFIG_DM_SPI_FLASH=y
CONFIG_SPI_FLASH=y
CONFIG_SPI_FLASH_SFDP_SUPPORT=y
CONFIG_SPI_FLASH_UNLOCK_ALL=n
CONFIG_SPI_FLASH_GIGADEVICE=y
CONFIG_SPI_FLASH_WINBOND=y
CONFIG_SPI_FLASH_USE_4K_SECTORS=y
# CONFIG_SPI_FLASH_MTD=y
# CONFIG_SPL_SPI_FLASH_MTD=y

# Env
# CONFIG_ENV_IS_IN_FAT is not set
CONFIG_ENV_IS_IN_SPI_FLASH=y
CONFIG_ENV_OVERWRITE=y
CONFIG_ENV_SIZE=0x80000
CONFIG_ENV_OFFSET=0x100000
CONFIG_ENV_SECT_SIZE=0x10000
CONFIG_SYS_CONSOLE_IS_IN_ENV=y

# Buttons
CONFIG_BUTTON=y
CONFIG_BUTTON_GPIO=y

# LED
CONFIG_LED=y
CONFIG_LED_GPIO=y
#CONFIG_LED_STATUS=y
#CONFIG_LED_STATUS_GPIO=y

# Commands
CONFIG_CMD_HASH=y
CONFIG_CMD_HASH_VERIFY=y
CONFIG_CMD_MTD=y
CONFIG_CMD_MTDPARTS=y
CONFIG_CMD_SPI=y

CONFIG_SYS_PROMPT="Celliwig> "
```
